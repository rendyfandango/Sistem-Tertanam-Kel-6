## TiltGuard-MPU6050/main/Kconfig.projbuild
```kconfig
menu "TiltGuard MPU6050"
    config TILTGUARD_SDA_GPIO
        int "I2C SDA GPIO"
        range 0 33
        default 21
    config TILTGUARD_SCL_GPIO
        int "I2C SCL GPIO"
        range 0 33
        default 22
    config TILTGUARD_MPU_ADDRESS
        hex "MPU6050 7-bit address (AD0 low: 0x68, high: 0x69)"
        range 0x68 0x69
        default 0x68
    config TILTGUARD_I2C_HZ
        int "MPU6050 I2C clock (Hz)"
        range 10000 400000
        default 400000
    config TILTGUARD_I2C_TIMEOUT_MS
        int "I2C transaction timeout (ms)"
        range 1 1000
        default 100
endmenu
```
